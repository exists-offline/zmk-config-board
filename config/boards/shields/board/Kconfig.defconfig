## config/boards/shields/board/Kconfig.defconfig
```kconfig
if SHIELD_BOARD_DONGLE

config ZMK_KEYBOARD_NAME
    default "board"

config ZMK_SPLIT_ROLE_CENTRAL
    default y

config ZMK_SPLIT_BLE_CENTRAL_PERIPHERALS
    default 2

endif


if SHIELD_BOARD_DONGLE || SHIELD_BOARD_LEFT || SHIELD_BOARD_RIGHT

config ZMK_SPLIT
    default y

endif
```

## config/boards/shields/board/Kconfig.shield
```kconfig
config SHIELD_BOARD_DONGLE
    def_bool $(shields_list_contains,board_dongle)

config SHIELD_BOARD_LEFT
    def_bool $(shields_list_contains,board_left)

config SHIELD_BOARD_RIGHT
    def_bool $(shields_list_contains,board_right)
```
